## conf/layer.conf
```bitbake
# We have a conf and classes directory, add to BBPATH
BBPATH .= ":${LAYERDIR}"

# We have recipes-* directories, add to BBFILES
BBFILES += "${LAYERDIR}/recipes-*/*/*.bb \
            ${LAYERDIR}/recipes-*/*/*.bbappend"

BBFILE_COLLECTIONS += "cellgain-mender"
BBFILE_PATTERN_cellgain-mender = "^${LAYERDIR}/"
BBFILE_PRIORITY_cellgain-mender = "6"

LAYERDEPENDS_cellgain-mender = "mender"

INHERIT += "rpi-wifi"

LAYERSERIES_COMPAT_cellgain-mender = "kirkstone"
```

## conf/local.conf.sample
```bitbake
MACHINE ??= "qemux86"

DISTRO ?= "poky"

PACKAGE_CLASSES ?= "package_rpm"

EXTRA_IMAGE_FEATURES ?= "debug-tweaks"

USER_CLASSES ?= "buildstats image-mklibs image-prelink"

PATCHRESOLVE = "noop"

BB_DISKMON_DIRS ??= "\
    STOPTASKS,${TMPDIR},1G,100K \ 
    STOPTASKS,${DL_DIR},1G,100K \
    STOPTASKS,${SSTATE_DIR},1G,100K \
    STOPTASKS,/tmp,100M,100K \
    ABORT,${TMPDIR},100M,1K \
    ABORT,${DL_DIR},100M,1K \
    ABORT,${SSTATE_DIR},100M,1K \
    ABORT,/tmp,10M,1K"

PACKAGECONFIG_append_pn-qemu-native = " sdl"
PACKAGECONFIG_append_pn-nativesdk-qemu = " sdl"
CONF_VERSION = "1"

###################################################
###
### Configuration added by yocto-mender-rpi3.sh
###
###################################################
KERNEL_DEVICETREE = "am335x-boneblack.dtb"

IMAGE_INSTALL_append = " net-snmp-server net-snmp-client net-snmp-libs net-snmp-mibs minicom libusb1 libusb1-dev usbutils"

DISTRO_FEATURES = "ext2 usbhost ${DISTRO_FEATURES_LIBC} kernel-module-cdc-acm"

PREFERRED_PROVIDER_udev = "eudev"

# remove pulseaudio since it brings in x11
DISTRO_FEATURES_BACKFILL_CONSIDERED += "pulseaudio opengl"

PREFERRED_PROVIDER_jpeg = "libjpeg-turbo"

PACKAGE_CLASSES = "package_ipk"

# i686 or x86_64
SDKMACHINE = "x86_64"

# Use the same type here as specified in ARTIFACTIMG_FSTYPE to avoid
# building an unneeded image file.
SDIMG_ROOTFS_TYPE = "ext4"

DISTRO_FEATURES_append = " systemd"
VIRTUAL-RUNTIME_init_manager = "systemd"
DISTRO_FEATURES_BACKFILL_CONSIDERED = "sysvinit"
VIRTUAL-RUNTIME_initscripts = ""

ARTIFACTIMG_FSTYPE = "ext4"

MENDER_ARTIFACT_NAME = "cellgain-release-bbb-0.2.12"

INHERIT += "mender-full extrausers rm_work"

# A MACHINE integrated with Mender.
# raspberrypi3, beaglebone-yocto, vexpress-qemu and qemux86-64 are reference devices
MACHINE = "beaglebone-yocto"
#MENDER_DATA_PART_SIZE_MB = "1024"

MENDER_STORAGE_DEVICE = "/dev/mmcblk1"
MENDER_SERVER_URL = "https://mender-cellgain.ddns.net"
MENDER_UPDATE_POLL_INTERVAL_SECONDS = "60"
MENDER_INVENTORY_POLL_INTERVAL_SECONDS = "60"

EXTRA_USERS_PARAMS = "usermod -P q1w2e3r4 root; "

VIRTUAL-RUNTIME_snmp-manager = "net-snmp-server"

NMS_MODE = "remote"

#autoload ethernet module at boot
KERNEL_MODULE_AUTOLOAD += " cdc_acm"
```
